## conf/distro/ivanz-distro.conf
```bitbake
MAINTAINER = "overkill74 <overkill.shininig@tiscali.it>"

require conf/distro/poky.conf

DISTRO = "ivanz-distro"
DISTRO_NAME = "ivanz distro"
DISTRO_VERSION = "1.0"
DISTRO_CODENAME = "ivanz"
SDK_VENDOR = "-ivanzdistro"
SDK_VERSION = "sdkversion"

# Set hostname
hostname_pn-base-files = "ovk74"

# Replace sysv with systemd
DISTRO_FEATURES += "systemd"
VIRTUAL-RUNTIME_init_manager = "systemd"
DISTRO_FEATURES_remove += "sysvinit"
VIRTUAL-RUNTIME_initscipts = "systemd-compat-units"
DISTRO_FEATURES_BACKFILL_CONSIDERED += "sysvinit"

# Set default timezone
DEFAULT_TIMEZONE = "Europe/Rome"
```

## conf/layer.conf
```bitbake
# We have a conf and classes directory, add to BBPATH
BBPATH .= ":${LAYERDIR}"

# We have recipes-* directories, add to BBFILES
BBFILES += "${LAYERDIR}/recipes-*/*/*.bb \
            ${LAYERDIR}/recipes-*/*/*.bbappend"

BBFILE_COLLECTIONS += "meta-ivanz"
BBFILE_PATTERN_meta-ivanz = "^${LAYERDIR}/"
BBFILE_PRIORITY_meta-ivanz = "6"

LAYERDEPENDS_meta-ivanz = "core"
LAYERSERIES_COMPAT_meta-ivanz = "warrior zeus"
```
